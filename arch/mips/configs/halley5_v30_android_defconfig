## module_drivers/drivers/video/fbdev/ingenic/fb_stage/epd/Kconfig
```kconfig
menuconfig FB_INGENIC_DISPLAYS_STAGE
	tristate "Supported epd panels and epd powersupply"
	depends on FB_INGENIC_STAGE
	depends on SF_EPD_DRIVER
	select BACKLIGHT_LCD_SUPPORT
	select LCD_CLASS_DEVICE
	select BACKLIGHT_CLASS_DEVICE


config PANEL_0PM060C1
	tristate "epd panel 0PM060C1"
	depends on FB_INGENIC_DISPLAYS_STAGE
	depends on SF_EPD_DRIVER
	help
		epd panel 0PM060C1, for ingenicfb drivers.

config POWER_FP9931
	tristate "epd panel powersupply FP9931"
	depends on FB_INGENIC_DISPLAYS_STAGE
	help
		epd panel powersupply FP9931.


config POWER_TPS65185
	tristate "epd panel powersupply TPS65185"
	depends on FB_INGENIC_DISPLAYS_STAGE
	help
		epd panel powersupply TPS65185.
```

## module_drivers/drivers/video/fbdev/ingenic/fb_stage_wip/Kconfig
```kconfig
menuconfig FB_INGENIC_STAGE_WIP
	tristate "Ingenic Framebuffer Driver for stage wip"
	depends on FB_INGENIC
	select FB_INGENIC_DISPLAYS_STAGE_WIP
	select FB_CFB_FILLRECT
	select FB_CFB_COPYAREA
	select FB_CFB_IMAGEBLIT
	select V4L2_MEM2MEM_DEV
	select VIDEOBUF2_DMA_CONTIG_INGENIC
	help
	  Framebuffer support for the Version 12 DPU SoC.
if FB_INGENIC_STAGE_WIP
source "$OUTSIDE_DRIVERS/drivers/video/fbdev/ingenic/fb_stage_wip/displays/Kconfig"
endif
```

## module_drivers/drivers/video/ingenic_S2D/Kconfig
```kconfig
config INGENIC_S2D
	tristate "Ingenic S2D Driver"
	depends on SOC_X2600
	default n
	help
	  Support for Ingenic simple image 2d operations.
```

## module_drivers/drivers/video/ingenic_avpu_v2/Kconfig
```kconfig
config INGENIC_AVPU_V2
	tristate "[VPU] ingenic soc avpu version 2(EL200) module"
	depends on SOC_X2580
	select VIDEOBUF2_DMA_CONTIG
	select VIDEOBUF2_DMA_CONTIG_INGENIC
	default n
	help
		this is ingenic avpu for x2580, support h264/h265/jpeg encoder.
```
