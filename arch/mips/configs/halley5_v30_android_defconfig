## module_drivers/drivers/media/platform/ingenic-isp/Kconfig
```kconfig
config VIC_DMA_ROUTE
	bool "vic dma out route enable"
	default n
	depends on VIDEO_INGENIC_ISP

config MSCA_BDEV
	bool "mscaler bdev support"
	default n
	depends on VIDEO_INGENIC_ISP

config INGENIC_ISP_SENSOR_NO_AE
	bool "isp total sensor no ae"
	default n
	depends on VIDEO_INGENIC_ISP
	---help---
	  Say Y here to disenable support for ISP AE.

# halley5 board
menuconfig HALLEY5_CAMERA_BOARD
	bool "halley5_camera_board"
	depends on VIDEO_INGENIC_ISP
	default n
	---help---
	  Say Y here to enable support for halley5_camera_boards.

config RD_X2000_HALLEY5_CAMERA_1V0
	bool "halley5 camera driver for RD_X2000_HALLEY5_CAMERA_1V0"
	depends on HALLEY5_CAMERA_BOARD
	select INGENIC_ISP_CAMERA_AR0144
	select INGENIC_ISP_CAMERA_AR0234

config RD_X2000_HALLEY5_CAMERA_2V1
	bool "halley5 camera driver for RD_X2000_HALLEY5_CAMERA_2V1"
	depends on HALLEY5_CAMERA_BOARD
	select INGENIC_ISP_CAMERA_OV2735B
	select INGENIC_ISP_CAMERA_OV2735A

config RD_X2000_HALLEY5_CAMERA_4V2
	bool "halley5 camera driver for RD_X2000_HALLEY5_CAMERA_4V2"
	depends on HALLEY5_CAMERA_BOARD
	select INGENIC_ISP_CAMERA_OV2735B
	select INGENIC_ISP_CAMERA_OV2735A

config RD_X2000_HALLEY5_CAMERA_4V3
	bool "halley5 camera driver for RD_X2000_HALLEY5_CAMERA_4V3"
	depends on HALLEY5_CAMERA_BOARD
	select INGENIC_ISP_CAMERA_OV2735A

config RD_X2000_HALLEY5_CAMERA_TWIN612
	bool "halley5 camera driver for RD_X2000_HALLEY5_CAMERA_TWIN612"
	depends on HALLEY5_CAMERA_BOARD
	select INGENIC_ISP_CAMERA_TWIN612

config RD_X2000_HALLEY5_CAMERA_3V2
	bool "halley5 camera driver for RD_X2000_HALLEY5_CAMERA_3V2"
	depends on HALLEY5_CAMERA_BOARD
	select INGENIC_ISP_CAMERA_OV4689

choice
	prompt "ov4689 resolution and frame rate select"
	depends on RD_X2000_HALLEY5_CAMERA_3V2
	default OV4689_1080P_30FPS
	help
	Select ov4689 sensor's resolution and frame rate that driver supported.

config OV4689_1080P_120FPS
	bool "OV4689_1080P_120fps"
	depends on RD_X2000_HALLEY5_CAMERA_3V2 || CAMERA_V10

config OV4689_1080P_30FPS
	bool "OV4689_1080P_30fps"
	depends on RD_X2000_HALLEY5_CAMERA_3V2 || CAMERA_V10

config OV4689_2048X1520_30FPS
	bool "ov4689_2048x1520_30fps"
	depends on RD_X2000_HALLEY5_CAMERA_3V2 || CAMERA_V10
endchoice

config RD_X2000_HALLEY5_CAMERA_5V0
	bool "halley5 camera driver for RD_X2000_HALLEY5_CAMERA_5V0"
	depends on HALLEY5_CAMERA_BOARD
	select INGENIC_ISP_CAMERA_AR0144

config RD_X2000_HALLEY5_CAMERA_7V0
	bool "halley5 camera driver for RD_X2000_HALLEY5_CAMERA_7V0"
	depends on HALLEY5_CAMERA_BOARD
	select INGENIC_ISP_CAMERA_GC2053

config RD_X2000_HALLEY5_CAMERA_8V0
	bool "halley5 camera driver for RD_X2000_HALLEY5_CAMERA_8V0"
	depends on HALLEY5_CAMERA_BOARD
	select INGENIC_ISP_CAMERA_SC120AT

config RD_X2000_HALLEY5_CAMERA_GC5035
	bool "halley5 camera driver for RD_X2000_HALLEY5_CAMERA_GC5035"
	depends on HALLEY5_CAMERA_BOARD
	select INGENIC_ISP_CAMERA_GC5035

config RD_X2500_HIPPO_CAMERA_1V1
	bool "halley5 camera driver for RD_X2500_HIPPO_CAMERA_1V1"
	depends on HALLEY5_CAMERA_BOARD
	select INGENIC_ISP_CAMERA_SC230AI

# gewu board
menuconfig GEWU_CAMERA_BOARD
	bool "gewu_camera_board"
	depends on VIDEO_INGENIC_ISP
	default n
	---help---
	  Say Y here to enable support for gewu_camera_boards.

config CAMERA_V10
	bool "gewu camera driver for CAMERA_1.0"
	depends on GEWU_CAMERA_BOARD
	select INGENIC_ISP_CAMERA_OV4689

choice
	prompt "ov4689 resolution and frame rate select"
	depends on CAMERA_V10
	default GEWU_OV4689_1080P_30FPS
	help
	Select ov4689 sensor's resolution and frame rate that driver supported.

config GEWU_OV4689_1080P_120FPS
	bool "OV4689_1080P_120fps"
	select OV4689_1080P_120FPS
	depends on CAMERA_V10

config GEWU_OV4689_1080P_30FPS
	bool "OV4689_1080P_30fps"
	select OV4689_1080P_30FPS
	depends on CAMERA_V10

config GEWU_OV4689_2048X1520_30FPS
	bool "ov4689_2048x1520_30fps"
	select OV4689_2048X1520_30FPS
	depends on CAMERA_V10
endchoice
```

## module_drivers/drivers/net/can/ingenic/Kconfig
```kconfig
menu "INGENIC CAN support"

config INGENIC_CAN
	tristate "ingenic on-chip CAN support"
#	depends on
	---help---
	  Driver for the Microchip INGENIC CAN controllers.

config INGENIC_CAN_USE_PDMA
	bool "ingenic can use dma transmission"
	default y
	depends on INGENIC_CAN
	---help---
	Configure CAN to use DMA to transfer data
config CAN_CLOCK
	int "set can clk freq (8/12/24M)"
	default 24
	---help---
		Configure CAN CLK-FREQ
endmenu
```

## module_drivers/drivers/net/wireless/Kconfig
```kconfig
source "module_drivers/drivers/net/wireless/bcmdhd/Kconfig"
source "module_drivers/drivers/net/wireless/bcmdhd_101_10_361/Kconfig"
source "module_drivers/drivers/net/wireless/realtek/rtl8723ds/Kconfig"
source "module_drivers/drivers/net/wireless/realtek/rtl8189fs/Kconfig"
source "module_drivers/drivers/net/wireless/atbm_wifi/Kconfig"
```

## module_drivers/drivers/net/wireless/bcmdhd_101_10_361/Kconfig
```kconfig
config BCMDHD_101_10_361
	tristate "Broadcom 101.10.361.x FullMAC wireless cards support"
	---help---
	  This module adds support for wireless adapters based on
	  Broadcom FullMAC chipset.

config BCMDHD_101_10_361_FW_PATH
	depends on BCMDHD_101_10_361
	string "Firmware path"
	default "/lib/firmware/fw_bcm43013c1_ag.bin"
	---help---
	  Path to the firmware file.

config BCMDHD_101_10_361_NVRAM_PATH
	depends on BCMDHD_101_10_361
	string "NVRAM path"
	default "/lib/firmware/nvram_ap6203bm.txt"
	---help---
	  Path to the calibration file.

config BCMDHD_101_10_361_WEXT
	bool "Enable WEXT support"
	depends on BCMDHD_101_10_361 && CFG80211 = n
	select WIRELESS_EXT
	select WEXT_PRIV
	help
	  Enables WEXT support

choice
	prompt "Enable Chip Interface"
	depends on BCMDHD_101_10_361
	---help---
		Enable Chip Interface.
config BCMDHD_101_10_361_SDIO
		bool "SDIO bus interface support"
		depends on BCMDHD_101_10_361 && MMC
config BCMDHD_101_10_361_PCIE
		bool "PCIe bus interface support"
		depends on BCMDHD_101_10_361 && PCI
config BCMDHD_101_10_361_USB
		bool "USB bus interface support"
		depends on BCMDHD_101_10_361 && USB
endchoice

choice
	depends on BCMDHD_101_10_361 && BCMDHD_101_10_361_SDIO
	prompt "Interrupt type"
	---help---
		Interrupt type
config BCMDHD_101_10_361_OOB
	depends on BCMDHD_101_10_361 && BCMDHD_101_10_361_SDIO
	bool "Out-of-Band Interrupt"
	---help---
		Interrupt from WL_HOST_WAKE.
config BCMDHD_101_10_361_SDIO_IRQ
	depends on BCMDHD_101_10_361 && BCMDHD_101_10_361_SDIO
	bool "In-Band Interrupt"
	---help---
	  Interrupt from SDIO DAT[1]
endchoice
```

## module_drivers/drivers/riscv/Kconfig
```kconfig
config X2500_RISCV
depends on SOC_X2500
default n
bool "x2500 riscv driver"
help
        Select to support riscv.

config X2600_RISCV
depends on SOC_X2600
default n
bool "x2600 riscv driver"
help
        Select to support riscv.
```

## module_drivers/drivers/video/fbdev/ingenic/Kconfig
```kconfig
menuconfig FB_INGENIC
	tristate "Ingenic Framebuffer Driver"
	depends on FB
	select FB_CFB_FILLRECT
	select FB_CFB_COPYAREA
	select FB_CFB_IMAGEBLIT
	help
		LCD Driver for INGENIC

config FB_FORMAT_X8B8G8R8
        bool "FB_FORMAT_X8B8G8R8 for Android"
        depends on FB_INGENIC
        default n
        help
          Disable Vsync skip

config FB_VSYNC_SKIP_DISABLE
        bool "Disable Vsync skip"
        depends on FB_INGENIC
        help
          Disable Vsync skip

config FB_VSYNC_SKIP
        int "Vsync skip ratio[0..9]"
        depends on FB_INGENIC
        default 9
        help
          Vsync skip ratio

config FB_INGENIC_NR_FRAMES
	int "how many frames support"
	depends on FB_INGENIC
	default 3

config FB_INGENIC_NR_LAYERS
	int "how many layers support"
	depends on FB_INGENIC
	default 4

config FB_INGENIC_DEBUG
        bool "fb test for displaying color bar"
        depends on FB_INGENIC
        default n
        help
           fb test for displaying color bar in your board.

config ROT_INGENIC
	tristate "X2600 Rotator"
	depends on SOC_X2600
	depends on FB_INGENIC
        default y
	---help---
	  This is the image rotation function of the x2600 series chip.

config ROT_INGENIC_BUFS
	int "how many rot buf support"
	depends on ROT_INGENIC
	default 2

config SLCDC_CONTINUA
    tristate "SLCDC CONTINUA TRANFER"
    depends on FB_INGENIC
    default n

config SLCDC_USE_TE
	tristate "SLCDC USE TE SIGNAL"
	depends on FB_INGENIC
	default n

config SF_EPD_DRIVER
	tristate "EPD by software control using sdma"
	depends on FB_INGENIC
	default n

config FB_USING_CACHABLE
	tristate "FrameBuffer map to user space by cachable."
	depends on FB_INGENIC
	default n

config PANEL_READ_ID
        bool "lcd panel_read_id"
	depends on FB_INGENIC
	default y
	help
		 lcd panel read id.
if FB_INGENIC
source "$OUTSIDE_DRIVERS/drivers/video/fbdev/ingenic/spi_fb_v12/Kconfig"
source "$OUTSIDE_DRIVERS/drivers/video/fbdev/ingenic/fb_stage/Kconfig"
source "$OUTSIDE_DRIVERS/drivers/video/fbdev/ingenic/fb_stage_wip/Kconfig"
endif
```

## module_drivers/drivers/video/fbdev/ingenic/fb_stage/displays/Kconfig
```kconfig
menuconfig FB_INGENIC_DISPLAYS_STAGE
	tristate "Supported lcd panels"
	depends on FB_INGENIC_STAGE
	select BACKLIGHT_LCD_SUPPORT
	select LCD_CLASS_DEVICE
	select BACKLIGHT_CLASS_DEVICE


config STAGE_Y88249
	tristate "lcd panel y88249"
	depends on FB_INGENIC_DISPLAYS_STAGE
	help
		lcd panel y88249, for ingenicfb drivers.

config STAGE_T070BEN050_02BT
	tristate "lcd panel T070BEN050_02BT"
	depends on FB_INGENIC_DISPLAYS_STAGE
	help
		lcd panel T070BEN050_02BT, for ingenicfb drivers.

config STAGE_SC7283
	tristate "lcd panel sc7283"
	depends on FB_INGENIC_DISPLAYS_STAGE
	help
		lcd panel sc7283, for ingenicfb drivers.

config STAGE_KD050HDFIA019
	tristate "lcd panel kd050hdfia019"
	depends on FB_INGENIC_DISPLAYS_STAGE
	help
		lcd panel kd050hdfia019, for ingenicfb drivers.

config STAGE_MA0060
	tristate "lcd panel MA0060"
	depends on FB_INGENIC_DISPLAYS_STAGE
	help
		lcd panel MA0060, for ingenicfb drivers.

config STAGE_FW050
	tristate "lcd panel FW050"
	depends on FB_INGENIC_DISPLAYS_STAGE
	help
		lcd panel FW050, for ingenicfb drivers.

config STAGE_ILI9488
	tristate "lcd panel ILI9488"
	depends on FB_INGENIC_DISPLAYS_STAGE
	help
		lcd panel ILI9488, for ingenicfb drivers.

config STAGE_ST7796S_320x480
	tristate "lcd panel ST7796S_320x480"
        depends on FB_INGENIC_DISPLAYS_STAGE
        help
        lcd panel ST7796S_320x480, for ingenicfb drivers.

config STAGE_FW040
	tristate "lcd panel FW040"
	depends on FB_INGENIC_DISPLAYS_STAGE
	help
		lcd panel FW040, for ingenicfb drivers.

config STAGE_FW035
	tristate "lcd panel FW035"
	depends on FB_INGENIC_DISPLAYS_STAGE
	help
		lcd panel FW035, for ingenicfb drivers.

config STAGE_TL040WVS03CT
	tristate "lcd panel tl040wvs03ct"
	depends on FB_INGENIC_DISPLAYS_STAGE
	help
		lcd panel tl040wvs03ct, for ingenicfb drivers.

config STAGE_TL040HDS01CT
	tristate "lcd panel tl040hds01ct"
	depends on FB_INGENIC_DISPLAYS_STAGE
	help
		lcd panel tl040hds01ct, for ingenicfb drivers.

config STAGE_JD9161Z
	tristate "lcd panel JD9161Z"
	depends on FB_INGENIC_DISPLAYS_STAGE
	help
		lcd panel JD9161Z, for ingenicfb drivers.

config STAGE_JD9365D
	tristate "lcd panel JD9365D"
	depends on FB_INGENIC_DISPLAYS_STAGE
	help
		lcd panel JD9365D, for ingenicfb drivers.

config STAGE_ATK7016
	tristate "lcd panel ATK7016"
	depends on FB_INGENIC_DISPLAYS_STAGE
	help
		lcd panel ATK7016, for ingenicfb drivers.

config STAGE_JD9365
	tristate "lcd panel JD9365"
	depends on FB_INGENIC_DISPLAYS_STAGE
	help
		lcd panel JD9365, for ingenicfb drivers.

config STAGE_GC9203
	tristate "lcd panel gc9203"
	depends on FB_INGENIC_DISPLAYS_STAGE
	help
		spi slcd panel r108104_gc9203, for ingenicfb drivers.

config STAGE_ST7701S
	tristate "lcd panel ST7701S"
	depends on FB_INGENIC_DISPLAYS_STAGE
	help
		lcd panel ST7701S, for ingenicfb drivers.

config STAGE_ST7701S_RGB666
	tristate "lcd panel ST7701S-RGB666"
	depends on FB_INGENIC_DISPLAYS_STAGE
	help
		lcd panel ST7701S spi+rgb (fmt:rgb666) interface, for ingenicfb drivers.

config STAGE_ST7701S_DX
	tristate "lcd panel st7701s_dx3.95ips"
	depends on FB_INGENIC_DISPLAYS_STAGE
	help
		lcd panel st7701s_dx3.95ips(mipi)480*480, for ingenicfb drivers.

config STAGE_GC9503V
	tristate "lcd panel GC9503V"
	depends on FB_INGENIC_DISPLAYS_STAGE
	help
		lcd panel GC9503V spi+rgb (fmt:rgb666) interface, for ingenicfb drivers.

config STAGE_YTS500XLAI
	tristate "lcd panel YTS500XLAI"
	depends on FB_INGENIC_DISPLAYS_STAGE
	help
		lcd panel YTS500XLAI, for ingenicfb drivers.

config STAGE_YLYM286A
	tristate "lcd panel ylym286a"
	depends on FB_INGENIC_DISPLAYS_STAGE
	help
		lcd panel ylym286a with bridge lt9211, for ingenicfb drivers.

config STAGE_KD035HVFBD037
	tristate "SLCD KD035HVFBD037 with control IC otm4802a (320x480)"
	depends on FB_INGENIC_DISPLAYS_STAGE
	help
		lcd panel KD035HVFBD037, for ingenicfb drivers.

config PANEL_STAGE_MV238FHM_N30
	tristate "lcd panel MV238FHM-N30"
	depends on FB_INGENIC_DISPLAYS_STAGE
	help
		lcd panel MV238FHM-N30 with bridge lt9211, for ingenicfb drivers.

config STAGE_EK79007AD
	tristate "lcd panel ek79007ad"
	depends on FB_INGENIC_DISPLAYS_STAGE
	help
		lcd panel EK79007AD, for ingenicfb drivers.

config STAGE_JD9366
	tristate "lcd panel JD9366"
	depends on FB_INGENIC_DISPLAYS_STAGE
	help
		lcd panel JD9366, for ingenicfb drivers.

config STAGE_BM8766
	tristate "tft bm8766 (480x800)"
	depends on FB_INGENIC_DISPLAYS_STAGE
	help
		lcd panel bm8766, for ingenicfb drivers.

config STAGE_KD050WVFPA029
	tristate "tft kd050wvfpa029 (800x480)"
	depends on FB_INGENIC_DISPLAYS_STAGE
	help
		lcd panel kd050wvfpa029, for ingenicfb drivers.

config STAGE_GWMTF16499B
	tristate "tft gwmtf16499b (240X320)"
	depends on FB_INGENIC_DISPLAYS_STAGE
	help
		lcd panel gwmtf16499b, for ingenicfb drivers.

config STAGE_ST7282
	tristate "lcd panel st7282"
	depends on FB_INGENIC_DISPLAYS_STAGE
	help
		lcd panel st7282, for ingenicfb drivers.

config STAGE_G104X1L04
	tristate "lcd panel G104X1L04"
	depends on FB_INGENIC_DISPLAYS_STAGE
	help
		lcd panel G104X1L04, for ingenicfb drivers.


config STAGE_KD035HVFMD057
	tristate "lcd panel kd035hvfmd057"
	depends on FB_INGENIC_DISPLAYS_STAGE
	help
		lcd panel kd035hvfmd057, for ingenicfb drivers.

config STAGE_ST7789V
	tristate "lcd panel st7789v"
	depends on FB_INGENIC_DISPLAYS_STAGE
	help
		lcd panel st7789v, for ingenicfb drivers.
config STAGE_ST7789V3
	tristate "lcd panel st7789v3"
	depends on FB_INGENIC_DISPLAYS_STAGE
	help
		lcd panel st7789v3 spi 4lane interface, for ingenicfb drivers.

config STAGE_MTF070WS
	tristate "lcd panel mtf070ws"
	depends on FB_INGENIC_DISPLAYS_STAGE
	help
		lcd panel mtf070ws, for ingenicfb drivers.

config STAGE_KHX101HW5
	tristate "lcd panel LVDS-lcd panel khx101hw5"
	depends on FB_INGENIC_DISPLAYS_STAGE
	help
		lcd panel lvds khx101hw5, for ingenicfb drivers.

config STAGE_HC050IV45011
	tristate "lcd panel mipi-lcd(1080p) panel hc050iv45011"
	depends on FB_INGENIC_DISPLAYS_STAGE
	help
		lcd panel mipi hc050iv45011, for ingenicfb drivers.

config STAGE_HC050IG40031
	tristate "tft panel hc050ig40031(800x480)"
	depends on FB_INGENIC_DISPLAYS_STAGE
	help
		lcd panel mipi hc050ig40031, for ingenicfb drivers.
config STAGE_HC070IK25
	tristate "lvds lcd hc070ik25 1024x600"
	depends on FB_INGENIC_DISPLAYS_STAGE
	help
		lcd panel lvds hc070ik25, for ingenicfb drivers.

config STAGE_HC101I35
	tristate "lvds lcd hc101i35 1280x800"
	depends on FB_INGENIC_DISPLAYS_STAGE
	help
		lcd panel lvds hc101i35, for ingenicfb drivers.

config STAGE_ZC50289HSHD02
	tristate "lcd panel ZC50289HSHD02"
	depends on FB_INGENIC_DISPLAYS_STAGE
	help
		lcd panel ZC50289HSHD02, for ingenicfb drivers.

config STAGE_AXS15231B
	tristate "lcd panel AXS15231B"
	depends on FB_INGENIC_DISPLAYS_STAGE
	help
		lcd panel AXS15231B, for ingenicfb drivers.
```
