## arch/mips/configs/hiby_r1_defconfig
```kconfig
CONFIG_MACH_XBURST=y
CONFIG_SOC_X1600=y
CONFIG_DT_X1600_MODULE_BASE=y
CONFIG_DT_X1600_MODULE_BASE_DTS_FILE="hiby_r1.dts"
CONFIG_CPU_MIPS32_R2=y
CONFIG_FORCE_MAX_ZONEORDER=15
# CONFIG_COMPACTION is not set
CONFIG_ZSMALLOC=y
CONFIG_HZ_100=y
CONFIG_PREEMPT=y
# CONFIG_SECCOMP is not set
CONFIG_MIPS_RAW_APPENDED_DTB=y
CONFIG_MIPS_CMDLINE_FROM_BOOTLOADER=y
CONFIG_CROSS_COMPILE="mips-linux-gnu-"
# CONFIG_LOCALVERSION_AUTO is not set
CONFIG_SYSVIPC=y
CONFIG_POSIX_MQUEUE=y
# CONFIG_CROSS_MEMORY_ATTACH is not set
CONFIG_FHANDLE=y
CONFIG_NO_HZ_IDLE=y
CONFIG_HIGH_RES_TIMERS=y
CONFIG_LOG_BUF_SHIFT=14
CONFIG_CC_OPTIMIZE_FOR_SIZE=y
CONFIG_EXPERT=y
CONFIG_SYSCTL_SYSCALL=y
# CONFIG_ADVISE_SYSCALLS is not set
# CONFIG_VM_EVENT_COUNTERS is not set
# CONFIG_COMPAT_BRK is not set
CONFIG_SLAB=y
CONFIG_MODULES=y
CONFIG_MODULE_FORCE_LOAD=y
CONFIG_MODULE_UNLOAD=y
# CONFIG_BLK_DEV_BSG is not set
CONFIG_PARTITION_ADVANCED=y
# CONFIG_IOSCHED_CFQ is not set
# CONFIG_COREDUMP is not set
CONFIG_NET=y
CONFIG_PACKET=y
CONFIG_UNIX=y
CONFIG_INET=y
CONFIG_IP_MULTICAST=y
CONFIG_IP_PNP=y
CONFIG_IP_PNP_DHCP=y
CONFIG_IP_PNP_BOOTP=y
CONFIG_IP_PNP_RARP=y
# CONFIG_INET_XFRM_MODE_TRANSPORT is not set
# CONFIG_INET_XFRM_MODE_TUNNEL is not set
# CONFIG_INET_XFRM_MODE_BEET is not set
# CONFIG_INET_LRO is not set
# CONFIG_IPV6 is not set
CONFIG_NETWORK_PHY_TIMESTAMPING=y
CONFIG_NETFILTER=y
CONFIG_NETFILTER_XT_TARGET_NFLOG=y
CONFIG_NETFILTER_XT_TARGET_NFQUEUE=y
CONFIG_NETFILTER_XT_MATCH_QUOTA=y
CONFIG_IP_SET=y
CONFIG_IP_SET_BITMAP_IPMAC=y
CONFIG_IP_NF_IPTABLES=y
CONFIG_IP_NF_FILTER=y
CONFIG_IP_NF_MANGLE=y
CONFIG_IP_NF_RAW=y
CONFIG_BT=y
CONFIG_BT_RFCOMM=y
CONFIG_BT_RFCOMM_TTY=y
CONFIG_BT_HIDP=y
# CONFIG_BT_HS is not set
CONFIG_BT_HCIUART=y
CONFIG_BT_HCIUART_H4=y
CONFIG_BT_HCIUART_LL=y
CONFIG_CFG80211=y
CONFIG_NL80211_TESTMODE=y
CONFIG_CFG80211_WEXT=y
CONFIG_RFKILL=y
CONFIG_RFKILL_INPUT=y
CONFIG_UEVENT_HELPER_PATH="/sbin/hotplug"
CONFIG_DEVTMPFS=y
CONFIG_DEVTMPFS_MOUNT=y
# CONFIG_STANDALONE is not set
# CONFIG_PREVENT_FIRMWARE_BUILD is not set
# CONFIG_ALLOW_DEV_COREDUMP is not set
CONFIG_REGMAP_IRQ=y
CONFIG_MTD=y
CONFIG_MTD_CMDLINE_PARTS=y
CONFIG_MTD_BLOCK=y
CONFIG_MTD_BLOCK_BBT_RO=y
CONFIG_MTD_UBI=y
CONFIG_ZRAM=y
CONFIG_ZRAM_LZ4_COMPRESS=y
CONFIG_BLK_DEV_LOOP=y
CONFIG_SCSI=y
CONFIG_BLK_DEV_SD=y
CONFIG_NETDEVICES=y
# CONFIG_ETHERNET is not set
CONFIG_BRCMFMAC=m
# CONFIG_INPUT_MOUSEDEV is not set
CONFIG_INPUT_EVDEV=y
# CONFIG_INPUT_KEYBOARD is not set
# CONFIG_INPUT_MOUSE is not set
CONFIG_INPUT_MISC=y
CONFIG_INPUT_UINPUT=y
# CONFIG_SERIO is not set
CONFIG_DEVPTS_MULTIPLE_INSTANCES=y
# CONFIG_LEGACY_PTYS is not set
# CONFIG_DEVKMEM is not set
# CONFIG_HW_RANDOM is not set
CONFIG_I2C=y
# CONFIG_I2C_COMPAT is not set
CONFIG_I2C_CHARDEV=y
CONFIG_SPI=y
CONFIG_SPI_BITBANG=y
CONFIG_PTP_1588_CLOCK=y
CONFIG_GPIO_SYSFS=y
CONFIG_GPIO_PCA953X=y
CONFIG_GPIO_PCA953X_IRQ=y
CONFIG_POWER_SUPPLY=y
# CONFIG_HWMON is not set
CONFIG_WATCHDOG=y
CONFIG_REGULATOR=y
CONFIG_REGULATOR_FIXED_VOLTAGE=y
CONFIG_REGULATOR_GPIO=y
CONFIG_FB=y
CONFIG_FB_MODE_HELPERS=y
CONFIG_BACKLIGHT_LCD_SUPPORT=y
CONFIG_LCD_CLASS_DEVICE=y
CONFIG_BACKLIGHT_CLASS_DEVICE=y
# CONFIG_BACKLIGHT_GENERIC is not set
# CONFIG_VGA_CONSOLE is not set
CONFIG_SOUND=y
CONFIG_SND=y
# CONFIG_SND_PCM_TIMER is not set
# CONFIG_SND_SUPPORT_OLD_API is not set
# CONFIG_SND_PROC_FS is not set
# CONFIG_SND_DRIVERS is not set
# CONFIG_SND_MIPS is not set
CONFIG_SND_USB_AUDIO=y
CONFIG_SND_SOC=y
CONFIG_HIDRAW=y
CONFIG_UHID=y
CONFIG_USB_HIDDEV=y
CONFIG_USB=y
CONFIG_USB_ANNOUNCE_NEW_DEVICES=y
CONFIG_USB_OTG=y
CONFIG_USB_STORAGE=y
CONFIG_USB_DWC2_NEW=y
CONFIG_USB_DWC2_NEW_EXT_ID_PIN=y
CONFIG_USB_DWC2_NEW_EXT_VBUS_DETECT=y
CONFIG_USB_DWC2_QUICK_START=y
CONFIG_INGENIC_USB_PHY=y
CONFIG_USB_GADGET=y
CONFIG_USB_CONFIGFS=y
CONFIG_USB_CONFIGFS_MASS_STORAGE=y
CONFIG_USB_CONFIGFS_F_FS=y
CONFIG_USB_CONFIGFS_UEVENT=y
CONFIG_USB_CONFIGFS_F_UAC_SA=y
CONFIG_USB_CONFIGFS_F_HID=y
CONFIG_MMC=y
CONFIG_MMC_BLOCK_MINORS=16
# CONFIG_MMC_BLOCK_BOUNCE is not set
CONFIG_MMC_SDHCI=y
CONFIG_INGENIC_MMC=y
CONFIG_INGENIC_MMC_MMC0=y
CONFIG_NEW_LEDS=y
CONFIG_LEDS_CLASS=y
CONFIG_LEDS_TRIGGERS=y
CONFIG_LEDS_TRIGGER_BREATHING=y
CONFIG_SWITCH=y
CONFIG_RTC_CLASS=y
CONFIG_DMADEVICES=y
CONFIG_INGENIC_PDMAC=y
# CONFIG_MIPS_PLATFORM_DEVICES is not set
# CONFIG_IOMMU_SUPPORT is not set
CONFIG_INGENIC_RPROC=y
CONFIG_GENERIC_PHY=y
# CONFIG_DNOTIFY is not set
CONFIG_FUSE_FS=y
CONFIG_ISO9660_FS=y
CONFIG_MSDOS_FS=y
CONFIG_VFAT_FS=y
CONFIG_FAT_DEFAULT_IOCHARSET="utf8"
CONFIG_EXFAT_FS=y
CONFIG_PROC_KCORE=y
# CONFIG_PROC_PAGE_MONITOR is not set
CONFIG_TMPFS=y
CONFIG_UBIFS_FS=y
CONFIG_UBIFS_FS_ADVANCED_COMPR=y
CONFIG_UBIFS_ATIME_SUPPORT=y
CONFIG_SQUASHFS=y
CONFIG_SQUASHFS_DECOMP_MULTI_PERCPU=y
CONFIG_SQUASHFS_XATTR=y
# CONFIG_SQUASHFS_ZLIB is not set
CONFIG_SQUASHFS_LZO=y
CONFIG_NLS_DEFAULT="utf8"
CONFIG_NLS_ASCII=y
CONFIG_PRINTK_TIME=y
# CONFIG_ENABLE_WARN_DEPRECATED is not set
# CONFIG_ENABLE_MUST_CHECK is not set
CONFIG_DEBUG_FS=y
# CONFIG_SECTION_MISMATCH_WARN_ONLY is not set
CONFIG_PANIC_TIMEOUT=10
# CONFIG_SCHED_DEBUG is not set
# CONFIG_DEBUG_PREEMPT is not set
CONFIG_STACKTRACE=y
# CONFIG_FTRACE is not set
CONFIG_CRYPTO_JENT_QUICK_START=y
CONFIG_CRYPTO_GF128MUL=y
CONFIG_CRYPTO_NULL=y
# CONFIG_CRYPTO_ECHAINIV is not set
CONFIG_CRYPTO_HMAC=y
# CONFIG_CRYPTO_HW is not set
CONFIG_SERIAL_INGENIC_UART=y
CONFIG_SERIAL_INGENIC_CONSOLE=y
CONFIG_INGENIC_DMA_RECEIVE_DXTERNAL_DECIDE=y
CONFIG_INGENIC_AIC_USES_PDMA=y
CONFIG_INGENIC_SFC=y
CONFIG_MTD_INGENIC_SFC_V2=y
CONFIG_MTD_INGENIC_SFC_NANDFLASH=y
CONFIG_INGENIC_SFCNAND_FMW=y
# CONFIG_INGENIC_CDBUS is not set
CONFIG_MFD_INGENIC_TCU=y
CONFIG_INGENIC_WDT=y
CONFIG_RTC_DRV_INGENIC=y
CONFIG_HIBY_MODULES=y
CONFIG_HIBY_UTILS=y
CONFIG_HIBY_SOC_UTILS=y
CONFIG_HIBY_SOC_GPIO=y
CONFIG_HIBY_SOC_PWM=y
CONFIG_HIBY_SOC_ADC=y
CONFIG_HIBY_SOC_EFUSE=y
CONFIG_HIBY_SA_CONFIG=y
CONFIG_HIBY_SOC_I2C=y
CONFIG_HIBY_SOC_AIC=y
CONFIG_HIBY_CW2015=m
CONFIG_HIBY_PWM_BACKLIGHT=y
CONFIG_HIBY_SA_SOUND_SWITCH=y
CONFIG_HIBY_LEDS_PWM_ADD=y
CONFIG_HIBY_TCS1421_ADD=y
CONFIG_HIBY_KEYBOARD_ADC_MULTIFUNC=y
```

## arch/mips/xburst2/soc-x2600/Kconfig.DT
```kconfig
config DT_X2600_MODULE_BASE
	bool "x2600 base for module drivers"
config DT_X2660_EVB
	bool "x2660 evb board"
config DT_X2600_TUCANA
	bool "x2600 tucana board"
config DT_X2660_HALLEY_V10
	bool "x2660 halley v1.0 board"
config DT_X2660_HALLEY_V11
	bool "x2660 halley v1.1 board"
config DT_X2670_HALLEY_V10
	bool "x2670 halley v1.0 board"
config DT_X2600E_HALLEY_V10
	bool "x2600E halley v1.0 board"
config DT_X2670M_HARE_V10
	bool "x2670m hare v1.0 board"
config DT_X2600_HALLEY_V10
	bool "x2600 halley v1.0 board"
config DT_X2600H_HALLEY_V10
	bool "x2600h halley v1.0 board"
```

## drivers/rpmsg/Kconfig
```kconfig
menu "Rpmsg drivers"

# RPMSG always gets selected by whoever wants it
config RPMSG
	tristate
	select VIRTIO
	select VIRTUALIZATION

config RPMSG_CHAR
	tristate "RPMSG device interface"
	depends on RPMSG
	depends on NET
	help
	  Say Y here to export rpmsg endpoints as device files, usually found
	  in /dev. They make it possible for user-space programs to send and
	  receive rpmsg packets.

endmenu
```

## drivers/usb/typec/Kconfig
```kconfig
menuconfig TYPEC
	tristate "USB Type-C Support"
	help
	  USB Type-C connector class: exposes the ports, their partners and
	  their roles under /sys/class/typec. Taken from Linux 4.16.

if TYPEC

config TYPEC_TCPM
	tristate "USB Type-C Port Controller Manager"
	depends on USB
	help
	  The Type-C Port Controller Manager provides a USB PD and USB Type-C
	  state machine for use with Type-C Port Controllers.

if TYPEC_TCPM

source "drivers/usb/typec/fusb302/Kconfig"

endif # TYPEC_TCPM

endif # TYPEC
```

## drivers/usb/typec/fusb302/Kconfig
```kconfig
config TYPEC_FUSB302
	tristate "Fairchild FUSB302 Type-C chip driver"
	depends on I2C && POWER_SUPPLY
	help
	  The Fairchild FUSB302 Type-C chip driver that works with
	  Type-C Port Controller Manager to provide USB PD and USB
	  Type-C functionalities. Also takes the HiBy board data
	  (struct fusb302_platform_data) that the stock fusb302b_add
	  module passes in.
```

## module_drivers/drivers/cpufreq/Kconfig
```kconfig
config X2000_CPUFREQ
	tristate "x2000 CPUFreq Driver"
	depends on SOC_X2000
	select  PM_OPP
	select	CPU_FREQ
	select  CPU_FREQ_GOV_COMMON
	select  CPU_FREQ_STAT
	select  CPU_FREQ_STAT_DETAILS
	select  CPU_FREQ_DEFAULT_GOV_PERFORMANCE
	select  CPU_FREQ_GOV_POWERSAVE
	select  CPU_FREQ_GOV_USERSPACE
	select  CPU_FREQ_GOV_ONDEMAND
	select  CPU_FREQ_GOV_CONSERVATIVE
	help
	  This option adds a CPUFreq driver for ingenic processors which
	  support software configurable cpu frequency.

	  X2000 and it's successors support this feature.

	  For details, take a look at <file:Documentation/cpu-freq/>.
```

## module_drivers/drivers/dma-buf/Kconfig
```kconfig
config DMABUF_HEAPS_RESERVEMEM
	bool "DMA-BUF Reserve Memory Heap"
	select DMA_SHARED_BUFFER
	help
	  Choose this option to enable the reserve memory dmabuf heap. The reserve memory heap
	  is backed by dma coherence allocate. If in doubt, say Y.
```

## module_drivers/drivers/input/touchscreen/ft6236_touch/Kconfig
```kconfig
#
# Focaltech Touchscreen driver configuration
#

config TOUCHSCREEN_FT6236
    tristate "FT6236 I2C touchscreen"
    help
      Say Y here if you have Focaltech touch panel.
      If unsure, say N.
```

## module_drivers/drivers/input/touchscreen/tsc2007_touch/Kconfig
```kconfig
config TOUCHSCREEN_TSC200X_CORE
	tristate

config TOUCHSCREEN_TSC2007
	tristate "TSC2007 based touchscreens"
	depends on I2C
	help
	  Say Y here if you have a TSC2007 based touchscreen.

	  If unsure, say N.

	  To compile this driver as a module, choose M here: the
	  module will be called tsc2007.

config TOUCHSCREEN_TSC2007_IIO
	bool "IIO interface for external ADC input and temperature"
	depends on TOUCHSCREEN_TSC2007
	depends on IIO=y || IIO=TOUCHSCREEN_TSC2007
	help
	  Saying Y here adds an iio interface to the tsc2007 which
	  provides values for the AUX input (used for e.g. battery
	  or ambient light monitoring), temperature and raw input
	  values.
```

## module_drivers/drivers/media/i2c/ingenic-cim/Kconfig
```kconfig
comment "ingenic-cim sensor drivers"

config INGENIC_CIM_CAMERA_AR0144
	tristate "ar0144 support"
	depends on VIDEO_INGENIC_CIM && I2C
	help
	  This is a ar0144 video driver

config INGENIC_CIM_CAMERA_OV2735B
	tristate "ov2735b support"
	depends on VIDEO_INGENIC_CIM && I2C
	help
	  This is a ov2735b video driver

config INGENIC_CIM_CAMERA_OV5640
	tristate "ov5640 camera DVP interface support"
	depends on VIDEO_INGENIC_CIM && I2C
	help
	  This is a ingenic-cim camera driver for the OmniVision OV5640 sensor DVP interface

config INGENIC_CIM_CAMERA_BT656_WY827
	tristate "WY827 camera BT656 interface support"
	depends on VIDEO_INGENIC_CIM && I2C
	help
	  This is a ingenic BT656 camera driver for the WY827 sensor interface

config INGENIC_CIM_CAMERA_DVP_SC031GS
	tristate "sc031gs dvp interface support"
	depends on VIDEO_INGENIC_CIM && I2C
	default n
	help
	  This is a sc031gs dvp interface video driver

config INGENIC_CIM_CAMERA_MIPI_SC031GS
	tristate "sc031gs mipi interface support"
	depends on VIDEO_INGENIC_CIM && I2C
	default n
	help
	  This is a sc031gs mipi interface video driver

config INGENIC_CIM_CAMERA_DVP_PSD030K
	tristate "psd030k dvp interface support"
	depends on VIDEO_INGENIC_CIM && I2C
	default n

config INGENIC_CIM_CAMERA_DVP_GC0308
	tristate "gc0308 dvp interface support"
	depends on VIDEO_INGENIC_CIM && I2C
	default n
	help
	  This is a gc0308 dvp interface video driver
```

## module_drivers/drivers/media/platform/ingenic-cim/Kconfig
```kconfig
config VIDEO_INGENIC_CIM
	tristate "Ingenic Soc Camera Driver for X2000 && M300 && X1600 && X2600"
        select VIDEOBUF2_DMA_CONTIG
	select VIDEOBUF2_DMA_CONTIG_INGENIC
	select V4L2_FWNODE
	help
		CIM Driver for X2000 && M300 && X1600 && X2600

menuconfig X2600_CAMERA_BOARD
	bool "x2600_camera_board"
	depends on VIDEO_INGENIC_CIM
	depends on SOC_X2600
	default n
	help
	  Say Y here to enable support for x2600_camera_boards.

config TUCANA_DVP_CAMERA
	bool "x2600_tucana camera driver for X2600_TUCANA_DVP_OV5640_CAMERA"
	depends on X2600_CAMERA_BOARD
	select INGENIC_CIM_CAMERA_OV5640

config	RD_X2600_DVP_CAMERA
	bool "x2600_camera driver for X2600_GC0308 DVP camera"
	depends on X2600_CAMERA_BOARD
	select INGENIC_CIM_CAMERA_DVP_GC0308

menuconfig PANDA_CAMERA_BOARD
	bool "panda_camera_board"
	depends on VIDEO_INGENIC_CIM
	depends on SOC_X1600
	default n
	help
	  Say Y here to enable support for panda_camera_boards.

config RD_X1600_PANDA_DVP_CAMERA_AND_LCD_1V0
	bool "panda camera driver for RD_X1600_PANDA_DVP_CAMERA_AND_LCD_V1.0"
	depends on PANDA_CAMERA_BOARD
	select INGENIC_CIM_CAMERA_OV5640

menuconfig HALLEY6_CAMERA_BOARD
	bool "halley6_camera_board"
	depends on VIDEO_INGENIC_CIM
	depends on SOC_X1600
	default n
	---help---
	  Say Y here to enable support for halley6_camera_boards.


config RD_X1600_HALLEY6_MIPI_CAMERA
	bool "halley6 camera driver for RD_X1600_HALLEY6_MIPI_SC031GS_CAMERA"
	depends on HALLEY6_CAMERA_BOARD
	select INGENIC_CIM_CAMERA_MIPI_SC031GS

config RD_X1600_HALLEY6_DVP_CAMERA
	bool "halley6 camera driver for RD_X1600_HALLEY6_DVP_SC031GS_CAMERA"
	depends on HALLEY6_CAMERA_BOARD
	select INGENIC_CIM_CAMERA_DVP_SC031GS

menuconfig EVB_CAMERA_BOARD
	bool "x1600 evb_camera_board"
	depends on VIDEO_INGENIC_CIM
	depends on SOC_X1600
	default n
	---help---
	  Say Y here to enable support for evb_camera_boards.

config RD_X1660_EVB_MIPI_CAMERA
	bool "x1660 camera driver for RD_X1660_EVB_MIPI_CAMERA"
	depends on EVB_CAMERA_BOARD
	select INGENIC_CIM_CAMERA_MIPI_SC031GS

config RD_X1660_EVB_DVP_CAMERA
	bool "x1660 camera driver for RD_X1660_EVB_DVP_CAMERA"
	depends on EVB_CAMERA_BOARD
	select INGENIC_CIM_CAMERA_DVP_SC031GS


menuconfig HALLEY5_CIM_CAMERA_BOARD
	bool "halley5_camera_board"
	depends on VIDEO_INGENIC_CIM
	depends on SOC_X2000
	default n
	---help---
	  Say Y here to enable support for halley5_camera_boards.


config RD_X2000_HALLEY5_CAMERA_CIM
	bool "halley5 camera driver for RD_X2000_HALLEY5_CAMERA_CIM"
	depends on HALLEY5_CIM_CAMERA_BOARD
	select INGENIC_CIM_CAMERA_AR0144
	select INGENIC_CIM_CAMERA_OV2735B

config RD_X2000_HALLEY5_CAMERA_5V0_CIM
	bool "halley5 camera driver for RD_X2000_HALLEY5_CAMERA_5V0_CIM"
	depends on HALLEY5_CIM_CAMERA_BOARD
	select INGENIC_CIM_CAMERA_AR0144

config RD_X2000_HALLEY5_CAMERA_4V2_CIM
	bool "halley5 camera driver for RD_X2000_HALLEY5_CAMERA_4V2_CIM"
	depends on HALLEY5_CIM_CAMERA_BOARD
	select INGENIC_CIM_CAMERA_OV2735B

config CAMERA_USE_SNAPSHOT
	bool "Sensor support snapshot function"
	depends on VIDEO_INGENIC_CIM
	help
		Sensor support snapshot function

config SNAPSHOT_PULSE_WIDTH
        int "Snapshot pulse width"
        depends on CAMERA_USE_SNAPSHOT
        default 8
        help
          Snapshot pulse width

config SNAPSHOT_FRAME_DELAY
        int "One frame end delay"
        depends on CAMERA_USE_SNAPSHOT
        default 100
        help
          One frame end delay
```
